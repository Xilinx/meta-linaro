## conf/layer.conf
```bitbake
BBPATH .= ":${LAYERDIR}"
BBFILES .= "${LAYERDIR}/recipes-*/*.bb \
            ${LAYERDIR}/recipes-*/*.bbappend \
            ${LAYERDIR}/recipes-*/*/*.bb \
            ${LAYERDIR}/recipes-*/*/*.bbappend"

BBFILE_COLLECTIONS += "linaro"
BBFILE_PATTERN_linaro := "^${LAYERDIR}/"
BBFILE_PRIORITY_linaro = "5"
```

## conf/machine/genericarmv8.conf
```bitbake
#@TYPE: Machine
#@NAME: generic armv8 machine
#@DESCRIPTION: generic machine to be used by linaro-media-create

require conf/machine/include/arm64/arch-armv8.inc

PREFERRED_PROVIDER_virtual/xserver ?= "xserver-xorg"

XSERVER ?= "xserver-xorg \
            mesa-dri-driver-swrast \
            xf86-input-evdev \
            xf86-input-mouse \
            xf86-video-fbdev \
            xf86-input-keyboard"

MACHINE_FEATURES = ""

# Don't include kernels in standard images
RDEPENDS_kernel-base = ""

PREFERRED_PROVIDER_virtual/kernel ?= "linux"

KERNEL_IMAGETYPE = "Image"

SERIAL_CONSOLE = "115200 ttyAMA0"
```

## conf/machine/include/arm64/arch-armv8.inc
```bitbake
DEFAULTTUNE ?= "aarch64"

ARMPKGARCH ?= "aarch64"

TUNEVALID[aarch64] = "Enable instructions for aarch64"
TUNECONFLICTS[aarch64] = ""
MACHINEOVERRIDES .= "${@bb.utils.contains("TUNE_FEATURES", "aarch64", ":aarch64", "" ,d)}"

# Little Endian base configs
AVAILTUNES += "aarch64"
TUNE_FEATURES_tune-aarch64 ?= "aarch64"

TUNE_ARCH = "aarch64"
TUNE_PKGARCH = "aarch64"

PACKAGE_EXTRA_ARCHS += "aarch64"

# toolchain bits which were in conf/site.conf

GCCVERSION       ?= "linaro-4.7"
SDKGCCVERSION    ?= "linaro-4.7"
BINUVERSION      ?= "2.23.51%"
LINUXLIBCVERSION ?= "3.7%"
```

## meta-aarch64/conf/machine/genericarmv8b.conf
```bitbake
#@TYPE: Machine
#@NAME: generic armv8 big endian machine
#@DESCRIPTION: generic machine to be used by linaro-media-create
DEFAULTTUNE = "aarch64_be"

require conf/machine/genericarmv8.conf
```

## meta-linaro-integration/conf/layer.conf
```bitbake
BBPATH .= ":${LAYERDIR}"
BBFILES += "\
            ${LAYERDIR}/recipes-*/*/*.bb \
            ${LAYERDIR}/recipes-*/*/*.bbappend \
           "

BBFILE_COLLECTIONS += "linaro-integration"
BBFILE_PATTERN_linaro-integration := "^${LAYERDIR}/"
BBFILE_PRIORITY_linaro-integration = "30"

LAYERSERIES_COMPAT_linaro-integration = "gatesgarth"

# do not error out on bbappends for missing recipes
BB_DANGLINGAPPENDS_WARNONLY = "true"

SIGGEN_EXCLUDE_SAFE_RECIPE_DEPS += " \
  gcc-cross-${TARGET_ARCH}->glibc \
"
```

## meta-linaro-toolchain/conf/distro/include/tcmode-linaro.inc
```bitbake
BINUVERSION = "linaro-2.27"
GCCVERSION = "linaro-6.2"
GDBVERSION = "linaro-7.8"
GLIBCVERSION = "linaro-2.23"

ENABLE_BINARY_LOCALE_GENERATION_forcevariable = "0"

require conf/distro/include/tcmode-default.inc
```

## meta-linaro/conf/machine/genericarmv7ab.conf
```bitbake
#@TYPE: Machine
#@NAME: generic armv7a big endian machine
#@DESCRIPTION: generic machine to be used by linaro-media-create

require conf/machine/genericarmv7a.conf
```

## meta-linaro/conf/machine/lng.inc
```bitbake
KERNEL_IMAGETYPE = "bzImage"

MACHINE_FEATURES += "x86"

EXTRA_IMAGE_FEATURES += "autoserial"
PACKAGE_GROUP_autoserial = "auto-serial-console"
```
